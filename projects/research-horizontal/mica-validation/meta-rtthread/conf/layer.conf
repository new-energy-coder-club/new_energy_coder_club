## projects/research-horizontal/mica-validation/meta-rtthread/conf/layer.conf
```bitbake
# We have a conf and classes directory, add to BBPATH
BBPATH .= ":${LAYERDIR}"

# We have recipes-* directories, add to BBFILES
BBFILES += "${LAYERDIR}/recipes-*/*.bb \
            ${LAYERDIR}/recipes-*/*.bbappend"

BBFILE_COLLECTIONS += "rtthread"
BBFILE_PATTERN_rtthread = "^${LAYERDIR}/"
BBFILE_PRIORITY_rtthread = "24"

LAYERVERSION_rtthread = "1"

LAYERDEPENDS:rtthread = "core"

LAYERSERIES_COMPAT_rtthread = "kirkstone"

# rtthread is built with scons
HOSTTOOLS:append = " scons"
```
